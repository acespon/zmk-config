## boards/shields/eva_board/Kconfig.defconfig
```kconfig
if SHIELD_EVA_BOARD_RIGHT

	config ZMK_KEYBOARD_NAME
		default "Eva Keyboard"

	config ZMK_SPLIT_ROLE_CENTRAL
		default y

endif

if SHIELD_EVA_BOARD_LEFT || SHIELD_EVA_BOARD_RIGHT

	config ZMK_SPLIT
		default y

endif
```

## boards/shields/eva_board/Kconfig.shield
```kconfig
config SHIELD_EVA_BOARD_LEFT
	def_bool $(shields_list_contains,eva_board_left)

config SHIELD_EVA_BOARD_RIGHT
	def_bool $(shields_list_contains.eva_board_right)
```
